## CMakeLists.txt
```
#
# Copyright (c) 2018 Nordic Semiconductor
#
# SPDX-License-Identifier: LicenseRef-BSD-5-Clause-Nordic
#
cmake_minimum_required(VERSION 3.8.2)

include($ENV{ZEPHYR_BASE}/../nrf/cmake/boilerplate.cmake)
include($ENV{ZEPHYR_BASE}/cmake/app/boilerplate.cmake NO_POLICY_SCOPE)
project(dsbox_gateway)

# DERSALIS DS-BOX APP START
target_sources(app PRIVATE src/main.c)

# Include application events and configuration headers
zephyr_library_include_directories(     
    src/libraries/lightning  
    src/libraries/net/at_cmd_parser
    src/libraries/net/net_lc
    src/libraries/net/mqtt_lc
    src/drivers/modem
)

# Application sources
add_subdirectory(src/libraries/lightning)
add_subdirectory(src/libraries/net/at_cmd_parser)
add_subdirectory(src/libraries/net/net_lc)
add_subdirectory(src/libraries/net/mqtt_lc)
add_subdirectory(src/drivers/modem)
```

## prj.conf
```kconfig
CONFIG_NCS_SAMPLES_DEFAULTS=y

# Enable the UART driver
CONFIG_UART_INTERRUPT_DRIVEN=y
CONFIG_SERIAL=y
CONFIG_CONSOLE=y
CONFIG_UART_CONSOLE=n
#CONFIG_UART_0_NRF_FLOW_CONTROL=y
#CONFIG_UART_1_NRF_FLOW_CONTROL=y


CONFIG_PRINTK=y
CONFIG_STDOUT_CONSOLE=y
CONFIG_LOG_BACKEND_RTT=y
CONFIG_RTT_CONSOLE=y
CONFIG_USE_SEGGER_RTT=y

# Enable the BLE stack with GATT Client configuration
CONFIG_BT=y
CONFIG_BT_CENTRAL=y
CONFIG_BT_SMP=y
CONFIG_BT_GATT_CLIENT=y

# Enable the BLE modules from NCS
CONFIG_BT_GATT_NUS_C=y
CONFIG_BT_SCAN=y
CONFIG_BT_SCAN_FILTER_ENABLE=y
CONFIG_BT_SCAN_UUID_CNT=1
CONFIG_BT_GATT_DM=y
CONFIG_HEAP_MEM_POOL_SIZE=2048

# This example requires more workqueue stack
CONFIG_SYSTEM_WORKQUEUE_STACK_SIZE=2048

# Enable bonding
CONFIG_BT_SETTINGS=y
CONFIG_FLASH=y
CONFIG_FLASH_PAGE_LAYOUT=y
CONFIG_FLASH_MAP=y
CONFIG_NVS=y
CONFIG_SETTINGS=y

CONFIG_NEWLIB_LIBC=y
```

## src/main.c
```c
/*
 * Copyright (c) 2020 Dersalis
 *
 */
#include <sys/printk.h>
#include <drivers/uart.h>

void main(void)
{
	printk("Dersalis gateway start\n");

	struct device *uart_dev = device_get_binding("UART_0");

	printk("device %p\n", uart_dev);
	
	for (;;) {	
	}
}
```
