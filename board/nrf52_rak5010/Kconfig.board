## board/nrf52_rak5010/Kconfig.board
```kconfig
# Rak5010 board configuration

# Copyright (c) 2016 Nordic Semiconductor ASA
# SPDX-License-Identifier: Apache-2.0

config BOARD_NRF52_RAK5010
	bool "nRF52 RAK5010"
	depends on SOC_NRF52840_QIAA
```

## board/nrf52_rak5010/Kconfig.defconfig
```kconfig
# Rak5010 board configuration

# Copyright (c) 2016 Nordic Semiconductor ASA
# SPDX-License-Identifier: Apache-2.0

if BOARD_NRF52_RAK5010

config BOARD
	default "nrf52_rak5010"

if ADC

config ADC_0
	default y

endif # ADC

if I2C

config I2C_0
	default y

endif # I2C

if PWM

config PWM_0
	default y

endif # PWM

if SPI

config SPI_1
	default y

config SPI_2
	default y

config SPI_3
	default y

endif # SPI

if USB

config USB_NRFX
	default y

config USB_DEVICE_STACK
	default y

endif # USB

if IEEE802154

config IEEE802154_NRF5
	default y

endif # IEEE802154

config BT_CTLR
	default BT

config MODEM
	default y

config MODEM_SHELL
	default y

config UART_1_NRF_UARTE
	default y

config UART_1_NRF_FLOW_CONTROL
	default y

config MODEM_QUECTEL_BG96
 	default y

config UART_INTERRUPT_DRIVEN
	default y

endif # BOARD_NRF52_RAK5010
```

## driver/bg96/Kconfig.quectel-bg96
```kconfig
# u-blox SARA R4 driver options

# Copyright (c) 2019 Foundries.io
# SPDX-License-Identifier: Apache-2.0

config MODEM_QUECTEL_BG96
	bool "Enable quectel BG96 modem driver"
	select MODEM_CONTEXT
	select MODEM_CMD_HANDLER
	select MODEM_IFACE_UART
	select MODEM_SOCKET
	select NET_OFFLOAD
	select NET_SOCKETS_OFFLOAD
	imply GPIO
	help
	  Choose this setting to enable quectel BG96 LTE-CatM1/NB-IoT/GPRS modem
	  driver.

if MODEM_QUECTEL_BG96

config MODEM_QUECTEL_BG96_NAME
	string "Driver name"
	default "MODEM_BG96"

config MODEM_QUECTEL_BG96_RX_STACK_SIZE
	int "Stack size for the quectel BG96 modem driver RX thread"
	default 1028
	help
	  This stack is used by the quectel BG96 RX thread.

config MODEM_QUECTEL_BG96_RX_WORKQ_STACK_SIZE
	int "Stack size for the quectel BG96 modem driver work queue"
	default 2048
	help
	  This stack is used by the work queue to pass off net_pkt data
	  to the rest of the network stack, letting the rx thread continue
	  processing data.

config MODEM_QUECTEL_BG96_APN
	string "APN for establishing network connection"
	default "hologram"
	help
	  This setting is used in the AT+CGDCONT command to set the APN name
	  for the network connection context.  This value is specific to
	  the network provider and may need to be changed.

config MODEM_QUECTEL_BG96_MANUAL_MCCMNO
	string "MCC/MNOfor establishing network connection"
	help
	  This setting is used in the AT+COPS command to set the MCC/MNO
	  for the network connection context.  This value is specific to
	  the network provider and may need to be changed if auto is not
	  selected.

config MODEM_QUECTEL_BG96_INIT_PRIORITY
	int "quectel BG96 driver init priority"
	default 80
	help
	  quectel BG96 device driver initialization priority.
	  Do not mess with it unless you know what you are doing.
	  Note that the priority needs to be lower than the net stack
	  so that it can start before the networking sub-system.

endif # MODEM_QUECTEL_BG96
```
